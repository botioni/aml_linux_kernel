## drivers/amlogic/nand/Kconfig
```kconfig
#
# Amlogic NAND device configuration
#

menu "AMLOGIC NAND Flash support"

config AM_NAND
	bool "Amlogic NAND FLASH M1/M2/M3 SUPPORT"
	    depends on AMLOGIC_SERIES
	default y
        select MTD_NAND 
	    select MTD_PARTITIONS
        select MTD_BLOCK
        select MTD_CHAR
        help
		This is Meson_M1 nand suport
		
config AML_NFTL
	tristate "Amlogic NFTL (NAND Flash Translation Layer) support"
	depends on (AM_NAND)
	default m
        help
		This is aml nftl suport
endmenu
```

## drivers/amlogic/net/Kconfig
```kconfig
#
# DCA server configuration
#
menu "Amlogic Net Device Support"

config AM_ETHERNET
	bool "Amloigc Ethetnet support"
	depends on  NET
	
endmenu
```

## drivers/amlogic/pmu/Kconfig
```kconfig
#
# AMLOGIC PMU DEVICE configuration
#

menu "Amlogic PMU Support"

config AMLOGIC_PMU_ENABLE
	tristate "AMLOGIC PMU Driver ENABLE"
	default n
	help
		AMLOGIC PMU Driver ENABLE(ACT8942...)

config PMU_ACT8942
	tristate "PMU ACT8942 Driver"
	default n
	depends on AMLOGIC_PMU_ENABLE
	help
		PMU_ACT8942 support

endmenu
```

## drivers/amlogic/power/Kconfig
```kconfig
menu "Amlogic Power Management Support"

config AMLOGIC_PM
	bool "Amlogic Power support"
	select POWER_SUPPLY
	default n
	help
	  Say Y here if you want to use the amlogic power management.

config SMBA10XX_BATTERY
	boolean "SMBA10XX battery driver support"
	depends on I2C_AML
	default n
	help
	  Say Y if you want to add battery driver supoort for SMBA10XX
	  
config BQ27x00_BATTERY
	bool "BQ27x00 Battery support"
	select POWER_SUPPLY
	depends on I2C_AML	
	default n
	help
	  Say Y here if you want to add battery driver supoort for bq27x00.
	  
config PMU_ACT8942
	bool "PMU ACT8942 Driver"
	select POWER_SUPPLY
	depends on I2C_AML	
	default n
	help
	  Say Y here if you want to add PMU ACT8942 supportsupoort.
	  
endmenu
```

## drivers/amlogic/ppmgr/Kconfig
```kconfig
#
# Post Process Manager device configuration
#

menu "AMLOGIC Post Process Manager driver"

config POST_PROCESS_MANAGER
    tristate "AMLOGIC Post Process Manager driver"
    default n
	help
	  Select to enable AMLOGIC Post Process Manager driver.
endmenu
```

## drivers/amlogic/rtc/Kconfig
```kconfig
#support amlogic rtc

menu "Amlogic RTC support"

comment "  Need RTC_CLASS "
config AML_RTC
		bool "Amlogic RTC support"
		default n
		depends on ARCH_MESON && RTC_CLASS
		
		help
		  This is amlogic inernal rtc driver
		  
endmenu
```

## drivers/amlogic/sata/Kconfig
```kconfig
menu "Amlogic SATA Support"

config SATA_DWC_AHCI
        bool "Amloigc SATA AHCI support"
				depends on ATA
        help
           depend on libATA


endmenu
```

## drivers/amlogic/smartcard/Kconfig
```kconfig
#
# Smart card driver configuration
#

menu "AMLOGIC Smart card driver"

config AM_SMARTCARD
	tristate "AMLOGIC Smart card driver"
	default y
	help
		Select to enable Smart card driver.
endmenu
```

## drivers/amlogic/sound/Kconfig
```kconfig
# ALSA ARC drivers

menu "Amlogic ALSA Audio devices"
	depends on AMLOGIC_BOARD

config	SND_AML
	tristate "Amlogic Audio driver"
	select	SOUND
	select	SND
	select	SND_PCM_OSS
	help
		"ALSA driver for AML"
	
endmenu	
```

## drivers/amlogic/spi_nor/Kconfig
```kconfig
#
# Sensor device configuration
#

menu "AMLOGIC SPI NOR Flash  support"


config APOLLO_SPI_NOR
	tristate "APOLLO SPI NOR FLASH SUPPORT"
  select MTD_DATA_FLASH 
  select MTD_PARTITIONS
  select MTD_BLOCK
  select MTD_CHAR
  select SPI
	help
		This is Apollo spi nor suport
		This driver can also be built as a module.  If so, the module
		will be called apollo_nand.ko
	  
endmenu
```

## drivers/amlogic/uart/Kconfig
```kconfig
menu "Amlogic UART Support"

config AM_UART
        bool "Amlogic Uart support"
        default y
        depends on ARCH_MESON
        help
           hardware uart

endmenu
```

## drivers/amlogic/usb/Kconfig
```kconfig
menu "Amlogic USB Support"

config USB_DWC_OTG_HCD
        bool "Amloigc usb host controler dwc_otg support"
        depends on USB
        help
           usb dwc_otg


endmenu
```

## drivers/amlogic/wifi/Kconfig
```kconfig
menu "Amlogic WIFI Support"


config SDIO_DHD_CDC_WIFI
	bool "Broadcom 4329 wireless cards support"
	depends on SD_MMC
	select WIRELESS_EXT
	select WEXT_PRIV
	---help---
	  This module adds support for wireless adapters based on
	  Broadcom 4329 chipset.

	  This driver uses the kernel's wireless extensions subsystem.
	  You should add bcm4329 firmware and nvram file in directory drivers/amlogic/wifi/
	  
          & assure to set these config in 
	  Device Drivers  ---> Generic Driver Options  ---> 

	  [*]   Include in-kernel firmware blobs in kernel binary  
          (broadcm_4329/nvram.txt broadcm_4329/sdio-g-cdc-full11n-reclaim-roml-wme-idsup.bin) External firmware blobs to build into 
	  
config BCM4329_FW_PATH
	depends on SDIO_DHD_CDC_WIFI
	string "BCM4329 Firmware path"
	default "broadcm_4329/sdio-g-cdc-full11n-reclaim-roml-wme-idsup.bin"
	---help---
	  Path to the firmware file.

config BCM4329_NVRAM_PATH
	depends on SDIO_DHD_CDC_WIFI
	string "BCM4329 NVRAM path"
	default "broadcm_4329/nvram.txt"
	---help---
	  Path to nvram file.

config RTL8712_8188_8191_8192SU_USB_WIFI
	tristate "Realtek 8712 8188 8191 8192SU Wireless USB Dongle support"
	default n
	depends on MAC80211 && USB
	---help---
	  This module adds support for wireless USB dongle based on
	  Realtek 8712 8188 8191 8192SU chipset.

config RTL8192CU_USB_WIFI
	tristate "Realtek 8192CU Wireless USB Dongle support"
	default n
	depends on MAC80211 && USB
	---help---
	  This module adds support for wireless USB dongle based on
	  Realtek 8192CU chipset.

config SDIO_ATHEROS_6302_WIFI
	bool "ATHEROS 6302 wireless cards support"
	depends on SD_MMC
	select WIRELESS_EXT
	select WEXT_PRIV
	---help---
	This module adds support for ATHEROS 6302 wireless cards support.
	
	This driver uses the kernel's wireless extensions subsystem.
	You should add ATHEROS 6302 firmware file in directory drivers/amlogic/wifi/
	
	    & assure to set these config in 
	Device Drivers  ---> Generic Driver Options  ---> 
	
	[*]   Include in-kernel firmware blobs in kernel binary  
	    (atheros_6302/otp.bin.z77 atheros_6302/athwlan.bin.z77 atheros_6302/data.patch.bin atheros_6302/bdata.SD31.bin) External firmware blobs to build into 

config AR6003_REV2_OTP_FILE
	depends on SDIO_ATHEROS_6302_WIFI
	string "ATHEROS_6302 OTP path"
	default "atheros_6302/otp.bin.z77"
	---help---
	  Path to the otp file.
	  
config AR6003_REV2_FIRMWARE_FILE
	depends on SDIO_ATHEROS_6302_WIFI
	string "ATHEROS_6302 FIRMWARE path"
	default "atheros_6302/athwlan.bin.z77"
	---help---
	  Path to the firmware file.
	  
config AR6003_REV2_PATCH_FILE
	depends on SDIO_ATHEROS_6302_WIFI
	string "ATHEROS_6302 PATCH path"
	default "atheros_6302/data.patch.bin"
	---help---
	  Path to the patch file.

config AR6003_REV2_BOARD_DATA_FILE
	depends on SDIO_ATHEROS_6302_WIFI
	string "ATHEROS_6302 BOARD_DATA path"
	default "atheros_6302/bdata.SD31.bin"
	---help---
	  Path to the bdata file.
	  	  	  
endmenu
```

## drivers/media/video/amlcamera/Kconfig
```kconfig
config VIDEO_AMLOGIC_CAPTURE_GT2005
	tristate "Amlogic Platform Capture Driver for GT2005"
	depends on VIDEO_AMLOGIC_CAPTURE
	select VIDEOBUF_VMALLOC
	select TVIN_BT656IN
	select TVIN_VDIN
	default n
	---help---
	  Amlogic capture driver.
	  Say Y here if you want this driver.
	  
config AMLOGIC_VIDEOIN_MANAGER
	tristate
```
