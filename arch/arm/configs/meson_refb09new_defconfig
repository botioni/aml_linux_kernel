## drivers/amlogic/jpeglogo/Kconfig
```kconfig
#
# JPEGLOGO device configuration
#

menu "AMLOGIC HW jpeg logo driver"
    depends on AMLOGIC_BOARD_APOLLO_H_LINUX

config JPEGLOGO
    bool "AMLOGIC HW jpeg logo driver"
    default n
	help
	  Select to enable JPEG logo driver.

config JPEGLOGO_ADDR
    hex "JPEG logo data address"
    depends on JPEGLOGO
    default 0x85800000
	help
	  JPEG logo data address.

config JPEGLOGO_SIZE
    int "JPEG logo data size"
    depends on JPEGLOGO
    default 102400
	help
	  JPEG logo data size.

endmenu
```

## drivers/amlogic/led/Kconfig
```kconfig
#
# LED device configuration
#

menu "AMLOGIC Linux Ref board LED support"
    depends on AMLOGIC_BOARD_APOLLO_H_LINUX

config LED
    tristate "APOLLO A1H Linux Ref board LED"
	help
	  Select to enable LED driver to control LEDs on Linux reference board.      
endmenu
```

## drivers/amlogic/mali/Kconfig
```kconfig
#
# Mali 400 GPU OpenGL device driver
#

menu "Mali 400 GPU OpenGL device driver"

config MALI
	bool "Mali 400 GPU OpenGL device driver"
	depends on m
	help
	  Enable kernel module build for Mali 400 OpenGL device driver.

endmenu
```
