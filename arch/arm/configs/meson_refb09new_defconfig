## arch/arm/mach-meson/Kconfig
```kconfig
menu "Meson platform type"
	depends on ARCH_MESON

config MACH_MESON_6236M
	bool "Support M1 6236(MODE:MBOX728) platform"
	help
	  Include support for the AMLOGIC M1 6236M Emulation Baseboard platform.

config MACH_MESON_8626M
	bool "Support M1 8626(MBOX_8626M1_V1.0) platform"
	help
	  Include support for the AMLOGIC M1 8626M Emulation Baseboard platform.

config MACH_MESON_6236M_SH
	bool "Support M1 6236(dpf_aml6236-m_innolux8_skt_v1) platform"
	help
	  Include support for the AMLOGIC M1 6236M Emulation Baseboard platform.

config MACH_MESON_8626M_SH
	bool "Support M1 8626(mbx_aml8626-m_skt_v1) platform"
	help
	  Include support for the AMLOGIC M1 8626M Emulation Baseboard platform.

config MESON_CLOCK_TICK_RATE
    int "Clock Tick Rate"
	default 25000000

endmenu
```

## arch/arm/mach-meson3/Kconfig
```kconfig
menu "Meson3 platform type"
	depends on ARCH_MESON3

config MACH_MESON3_REFF01
	select GENERIC_ALLOCATOR
	bool "Support M3 (M3_SKT_V1) platform"
	help
	  Include support for the AMLOGIC M3 Socket Emulation Baseboard platform.

config MACH_MESON3_REFF02
	select GENERIC_ALLOCATOR
	bool "Support M3 (WA) platform"
	help
	  Include support for the WA M3 board platform.
	  
config MACH_MESON3_REFF03
	select GENERIC_ALLOCATOR
	bool "Support M3 (Shuttle) platform"
	help
	  Include support for the Shuttle M3 board platform.	  

config MACH_MESON3_REFF04
	select GENERIC_ALLOCATOR
	bool "Support M3 (Ramos) platform"
	help
	  Include support for the Ramos M3 board platform.

config MACH_MESON3_REFF05
	select GENERIC_ALLOCATOR
	bool "Support M3 (SOCKET) platform"
	help
	  Include support for the AML M3 socket board platform.

config MACH_MESON3_REFF06
	select GENERIC_ALLOCATOR
	bool "Support M3 (Ainol) platform"
	help
	  Include support for the AML M3 socket board platform.

config MACH_MESON3_REFF07
	select GENERIC_ALLOCATOR
	bool "Support M3 (Malata) platform"
	help
	  Include support for the AML M3 Malata board platform.
	    
config MACH_MESON3_REFF08
	select GENERIC_ALLOCATOR
	bool "Support M3 F08 platform"
	help
	  Include support for the AML M3 socket board platform.

config MACH_MESON3_REFF09
	select GENERIC_ALLOCATOR
	bool "Support M3 F09 platform"
	help
	  Include support for the AML M3 board platform.

config MESON3_CLOCK_TICK_RATE
    int "Clock Tick Rate"
	default 25000000

config AML_SUSPEND
		bool "Support M3 A9 domain power down"
		depends on SUSPEND
		default n
		
endmenu
```

## drivers/amlogic/Kconfig
```kconfig
#
# Amlogic driver configuration
#
menu "Amlogic Device Drivers"
	depends on ARCH_MESON

source "drivers/amlogic/uart/Kconfig"
source "drivers/amlogic/net/Kconfig"
source "drivers/amlogic/usb/Kconfig"
source "drivers/amlogic/canvas/Kconfig"
source "drivers/amlogic/display/Kconfig"
#source "drivers/amlogic/cardreader/Kconfig"
source "drivers/amlogic/amports/Kconfig"
#source "drivers/amlogic/i2c/Kconfig"
#source "drivers/amlogic/hdmi/Kconfig"
source "drivers/amlogic/nand/Kconfig"
source "drivers/amlogic/sound/Kconfig"
source "drivers/amlogic/input/Kconfig"
#source "drivers/amlogic/audiodsp/Kconfig"
#source "drivers/amlogic/led/Kconfig"
#source "drivers/amlogic/cmem/Kconfig"
#source "drivers/amlogic/jpeglogo/Kconfig"
#source "drivers/amlogic/spi_nor/Kconfig"
endmenu	
```

## drivers/amlogic/audiodsp/Kconfig
```kconfig
#
# audio dsp  configuration
#
menu "Amlogic audio dsp process "

config  AML_AUDIO_DSP
	tristate  "audio dsp control support "
	default y
	depends on AML_AUDIO_DSP_LOG
	help  
		aupport the audio dsp ;
		

endmenu	
```

## drivers/amlogic/camera/Kconfig
```kconfig
#
# AMLOGIC CAMERA DEVICE configuration
#

menu "Amlogic CAMERA Support"

#config CAMERA_OV2655
#	tristate "CAMERA OV2655 Driver"
#	default n
#	help
#		.MICRON 0.3M Bayer Sensor with AutoFocus
		
#config CAMERA_OV2665
#	tristate "CAMERA OV2665 Driver"
#	default n
#	help
#		.MICRON 2M Bayer Sensor with AutoFocus


config AMLOGIC_CAMERA_ENABLE
	tristate "AMLOGIC CAMERA Driver ENABLE"
	default n
	help
		MICRON 5M Bayer Sensor with AutoFocus
				
config CAMERA_OV5640
	tristate "CAMERA OV5640 Driver"
	default n
	help
		MICRON 5M Bayer Sensor with AutoFocus
		
config CAMERA_GC0308
	tristate "CAMERA GC0308 Driver"
	default n
	help
		GalaxyCore GC0308
endmenu
```

## drivers/amlogic/clock600/Kconfig
```kconfig
#
# CLOCK600 device configuration
#

menu "AMLOGIC CLOCK600"

config CLOCK600
    tristate "CLOCK600"
	help
	  Select to enable CLOCK600.
endmenu
```

## drivers/amlogic/cmem/Kconfig
```kconfig
#
# CMEM device configuration
#

menu "AMLOGIC Physical memory allocator"

config CMEM
    tristate "CMEM Physical memory allocator"
	help
	  Select to enable CMEM physical memory allocator driver.
endmenu
```

## drivers/amlogic/demod/Kconfig
```kconfig
menu "AMLOGIC DEMOD Support"

menuconfig AM_DEMOD
	tristate "Amlogic demod driver"
	default y
	help
		m1 internal Demod DVB-T/C suport

if AM_DEMOD

config AM_DEMOD_DEBUG
	bool "Amlogic Demod Debug Interface"
	default n
	help
		m1 internal Demod debug interface

config AM_AMDEMOD_DVBC
	bool "AML DVBC demod driver"
	default y
	help
		m1 internal Demod DVB-C Driver

config AM_AMDEMOD_DVBT
	bool "AML DVBT demod driver"
	default y
	help
		m1 internal Demod DVB-T Driver

endif	# AM_DEMOD
		
endmenu
```

## drivers/amlogic/display/Kconfig
```kconfig
#
# Amlogic display driver configuration
#
menu "Amlogic Display Driver"

source "drivers/amlogic/display/vout/Kconfig"

source "drivers/amlogic/display/osd/Kconfig"

config  AM_GE2D
	tristate  "ge2d module"
	default y
	help 
		ge2d graphic  engine support

config  FB_AM_LOGO
	bool  "setup logo"
	default n
	depends on FB_AM
	help 
		setup logo support osd parameter offered by Uboot 

config  FB_AM_LOGO_ON_OSD0
	bool  "logo on osd0"
	default  y 
	depends on (FB_AM_LOGO )
	help 
 		display logo display on osd0 if y ,on osd1 if no
endmenu	
```

## drivers/amlogic/display/osd_ext/Kconfig
```kconfig
#
# Frame buffer configuration
#
menu "Amlogic OSD_EXT module"

config AM_FB_EXT
	tristate "Amlogic OSD_EXT support"
	depends on FB
	select FB_CFB_FILLRECT
	select FB_CFB_COPYAREA
	select FB_CFB_IMAGEBLIT
	select AM_CANVAS
	help
		This is the frame buffer device driver.
endmenu
```

## drivers/amlogic/display/vout/Kconfig
```kconfig
#
# Video output configuration
#
menu "Amlogic video output module"

config AM_TV_OUTPUT
	tristate "TV output"
	default y
	help  
		tv output module

config AM_TCON_OUTPUT
	tristate "LCD output" 
	help  
		LCD output module

choice
    prompt "LCD Output I/F Type"
    depends on AM_TCON_OUTPUT
    help
        For TFT LCD panels, there are three interfaces: RGB TTL I/F for Traditional panels, LVDS I/F for for New high resolution panels, and MiniLVDS I/F for special panels.
        Our early chips only support RGB TTL I/F. From M3 chips, also support LVDS and MiniLVDS I/F.

config AM_LCD_TTL_OUTPUT
    bool "RGB TTL Interface"
    help
        LCD output module, RGB TTL Interface, for Tranditional lcd panels

config AM_LCD_LVDS_OUTPUT
    bool "LVDS Interface"
    help        
        LCD output module, Internal LVDS Interface, for new high resolution panels

config AM_LCD_MLVDS_OUTPUT
    bool "miniLVDS Interface"
    help        
        LCD output module, Internal miniLVDS Interface, for special panels
endchoice

config AML_TTL_M3_EXAMPLE
	tristate "M3 TTL example panel driver"
	depends on  AM_LCD_TTL_OUTPUT
	help  
		M3 TTL example panel module

config AML_TCON_T13
	tristate "T13 panel driver"
	depends on  AM_LCD_TTL_OUTPUT
	help  
		T13 LCD panel module

config AML_TCON_ML10
	tristate "ML10 panel driver"
	depends on  AM_LCD_TTL_OUTPUT
	help  
		ML10 LCD panel module

config AML_TCON_W10
	tristate "W10 panel driver"
	depends on  AM_LCD_TTL_OUTPUT
	help  
		W10 LCD panel module

config AML_TCON_W7
	tristate "W7 panel driver"
	depends on  AM_LCD_TTL_OUTPUT
	help  
		W7 LCD panel module

config AML_TCON_W7NEW
	tristate "W7NEW panel driver"
	depends on  AM_LCD_TTL_OUTPUT
	help  
		W7NEW LCD panel module
		
config AML_TCON_W8
	tristate "W8 panel driver"
	depends on  AM_LCD_TTL_OUTPUT
	help  
		W8 LCD panel module

config AML_TCON_P7
	tristate "P7 panel driver"
	depends on  AM_LCD_TTL_OUTPUT
	help  
		P7 LCD panel module

config AML_TCON_K7
	tristate "K7 panel driver"
	depends on  AM_LCD_TTL_OUTPUT
	help  
		K7 LCD panel module
			
config AML_TCON_C7
	tristate "C7 panel driver"
	depends on  AM_LCD_TTL_OUTPUT
	help  
		C7 LCD panel module	
		
config AML_TCON_K8
	tristate "K8 panel driver"
	depends on  AM_LCD_TTL_OUTPUT
	help  
		K8 LCD panel module
		
config AML_TCON_G7
	tristate "G7 panel driver"
	depends on  AM_LCD_TTL_OUTPUT
	help  
		G7 LCD panel module
		
config AML_TCON_A18
	tristate "A18 panel driver"
	depends on  AM_LCD_TTL_OUTPUT
	help  
		A18 LCD panel module

config AML_TCON_A19
	tristate "A19 panel driver"
	depends on  AM_LCD_TTL_OUTPUT
	help  
		A19 LCD panel module

config AML_TCON_R10
	tristate "R10 panel driver"
	depends on  AM_LCD_TTL_OUTPUT
	help  
		R10 LCD panel module

config AML_TCON_REFB13
	tristate "REFB13 panel driver"
	depends on  AM_LCD_TTL_OUTPUT
	help  
		REFB13 LCD panel module

config AML_TCON_REFB14
	tristate "REFB14 panel driver"
	depends on  AM_LCD_TTL_OUTPUT
	help  
		REFB14 LCD panel module	

config AML_TCON_T10
	tristate "T10 panel driver"
	depends on  AM_LCD_TTL_OUTPUT
	help  
		T10 LCD panel module		
		
config AML_TCON_REFB17
	tristate "REFB17 panel driver"
	depends on  AM_LCD_TTL_OUTPUT
	help  
		T13 LCD panel module	
config AML_TCON_P10
	tristate "P10 panel driver"
	depends on  AM_LCD_TTL_OUTPUT
	help  
		P10 LCD panel module
config AML_TCON_Y7
	tristate "Y7 panel driver"
	depends on  AM_LCD_TTL_OUTPUT
	help  
		Y7 LCD panel module

config AML_LVDS_R_AT070TNA2
	tristate "R_AT070TNA2"
	depends on AM_LCD_LVDS_OUTPUT
	help
		AT070TNA2 LVDS panel.

config AML_MLVDS_A_TM080XDH		
	tristate "A_TM080XDH"
	depends on AM_LCD_MLVDS_OUTPUT
	help
		TM080XDH miniLVDS panel.

		
endmenu
	
```

## drivers/amlogic/dvb/Kconfig
```kconfig
#
# Smart card driver configuration
#

menu "AMLOGIC DVB driver"

config AM_DVB
	tristate "AMLOGIC DVB driver"
	default n
	depends on DVB_CORE
	help
		Select to enable AMLogic DVB driver.

config AM_GX1001
	tristate "GX1001 demod driver"
	default n
	depends on AM_DVB
	help
		Select to enable GX1001 demod driver.
		
config AM_MXL101
	tristate "MXL101 demod driver"
	default n
	depends on AM_DVB
	help
		Select to enable MXL101 demod driver.
		
config AM_AVL6211
	tristate "AVL6211 demod driver"
	default n
	depends on AM_DVB
	help
		Select to enable AVL6211 demod driver.		
		

endmenu
```

## drivers/amlogic/extern_io/Kconfig
```kconfig
menu "Extern io tca6424 Support"


config TCA6424
	bool "tca6424 extern io support"
	depends on I2C_AML
	default n
	---help---
	  This module adds support for tca6424 extern io

endmenu
```

## drivers/amlogic/hdmi/Kconfig
```kconfig
menu "Amlogic HDMI Support"


config AML_APOLLO_HDMI
        tristate "HDMI output enable"
        default y
        depends on  FB_AML_APOLLO && I2C
        help  
                hdmi output enable,It should be enalbe if board have hdmi out interface

endmenu
```

## drivers/amlogic/i2c/Kconfig
```kconfig
#
# Sensor device configuration
#

menu "AMLOGIC I2C Hardware Bus support"
    depends on AMLOGIC_BOARD

config I2C_APOLLO
    tristate "APOLLO I2C Controller"
	select I2C 
        select I2C_CHARDEV
	help
	  If you say yes to this option, support will be included for the I2c
	  controller on ARC APOLLO CHIP.  

	  This driver can also be built as a module.  If so, the module
	  will be called i2c-apollo.
endmenu
```

## drivers/amlogic/input/Kconfig
```kconfig
#
# Input device configuration
#

menu "Amlogic Input device support"

source "drivers/amlogic/input/irremote/Kconfig"

source "drivers/amlogic/input/saradc/Kconfig"

source "drivers/amlogic/input/adc_ts/Kconfig"

source "drivers/amlogic/input/adc_keypad/Kconfig"

endmenu
```

## drivers/amlogic/input/adc_keypad/Kconfig
```kconfig
#
# Input core configuration
#



config ADC_KEYPADS_AM
	tristate "Amlogic ADC keypad support"
	default n
	help
	  Say Y here if you want to use the amlogic ADC keypad.

	  To compile this driver as a module, choose M here: the
	  module will be called .
```

## drivers/amlogic/input/irremote/Kconfig
```kconfig
#
# Input core configuration
#



menuconfig KEYPADS_AM
	bool "Amlogic ir remote control support"
	default n
	help
	  Say Y here if you want to use the amlogic remote control.

	  To compile this driver as a module, choose M here: the
	  module will be called .

choice
        prompt "Choice remote control type"
        depends on KEYPADS_AM

config IR_REMOTE_DEFAULT
        bool "Default NULL key map"

config IR_REMOTE_HISENSE
        bool "Support for Hisense Remote Control"

config IR_REMOTE_SKYWORTH
        bool "Support for Skyworth Remote Control"

endchoice

config VIRTUAL_REMOTE
	tristate "Amlogic virtual ir remote support (only for QA test)"
	default n
	help
	  Say Y here if you want to use the virtual remote keypad.
	  It can fill a series of key events into input device for QA
	  test UI code.

	  To compile this driver as a module, choose M here: the
	  module will be called .
```

## drivers/amlogic/input/irremote_kernel/Kconfig
```kconfig
#
# Input core configuration
#



config KEYPADS_APOLLO
	tristate "Amlogic ir remote  keypads support"
	depends on (AMLOGIC_BOARD)
	default n
	help
	  Say Y here if you want to use the amlogic remote keypad.

	  To compile this driver as a module, choose M here: the
	  module will be called .
config  KEYPADS_APOLLO_DEBUG
	bool "keypas apollo debug mode "
	depends on (KEYPADS_APOLLO)
	default  n 
	help
		say y if you want print debug info of this module .
config   KEYPADS_APOLLO_REPEAT_ENABLE
	bool "keypads repeate enable"
	depends on (KEYPADS_APOLLO)
	default n
	help
		say y if you want enable repeat key.
choice
        prompt "apollo kpads output mode"
        depends on (KEYPADS_APOLLO)
        default  KEYPADS_APOLLO_REPORT_VKCODE

config KEYPADS_APOLLO_REPORT_SCANCODE
       bool	"scancode"
	 help
         this is a choice for report scancode

config  KEYPADS_APOLLO_REPORT_VKCODE
        bool "VK code"
        help
          this is a choice for report VKcode 

endchoice

choice
	prompt "keypads apollo decoder type"
	depends on (KEYPADS_APOLLO)
	default  KEYPADS_APOLLO_DECODER_HW
	
config   KEYPADS_APOLLO_DECODER_HW
	 bool "hardware"
	 help
	 	use hardware decoder
	 	
config   KEYPADS_APOLLO_DECODER_SW
	 bool "software"
	 help
	 	use software decoder	 	

endchoice

choice 
	prompt "apollo kpads manufacture for SW mode"
      depends on (KEYPADS_APOLLO_DECODER_SW)
      default  KEYPADS_APOLLO_DECODER_SW_SKYWORTH
      
config   KEYPADS_APOLLO_DECODER_SW_SKYWORTH
	bool "SKY WORTH"

config   KEYPADS_APOLLO_DECODER_SW_NEC
	bool "NEC"

endchoice
```

## drivers/amlogic/input/touch_keypad/Kconfig
```kconfig
#
# Input core configuration
#

config TOUCH_KEY_PAD_IT7230
	tristate "IT7230 touch key pad support"
	default n
	help
	  Say Y here if you want to use the IT7230 touch key pad support.

	  To compile this driver as a module, choose M here: the
	  module will be called .
```

## drivers/amlogic/input/touch_screen/Kconfig
```kconfig
#
# Input core configuration
#

config SINTEK_CAPACITIVE_TOUCHSCREEN
	tristate "Sintek capacitive touch panel"
	default n
	help
	  Say Y here if you want to use the Sintek capacitive panel.

	  To compile this driver as a module, choose M here: the
	  module will be called .

config ITK_CAPACITIVE_TOUCHSCREEN
	tristate "ITK capacitive touch panel"
	default n
	help
	  Say Y here if you want to use the ITK capacitive panel.

	  To compile this driver as a module, choose M here: the
	  module will be called .
```
